## drivers/leds/aw20036/Kconfig
```kconfig
config LEDS_AW20036
	tristate "LED Support for AW20036"
	depends on LEDS_CLASS && I2C
	help
		this option enables support for the AW20036RGB LED connected
		through I2C. Say Y to enable support for the AW20036LED
		light automatically.
```

## drivers/misc/haptic/Kconfig
```kconfig
#
# ICS_HAPTIC_DRV Driver
#

config ICS_HAPTIC_DRV
	tristate "ICS_HAPTIC_DRV driver"
	depends on I2C
	help
	  Say Y here if you have AAC/ICS RT6010 haptic controller
	  chip in your system.
	  If unsure, say N.
	  To compile this driver as a module, choose M here: the
	  module will be called aac_haptic_drv.
```

## drivers/nothing_stability/Kconfig
```kconfig
config NOTHING_BOOTLOADER_LOG
	tristate "Nothing bootloader log driver"
	default n
	help
		show booloader_log under proc/bootloader_log

config NOTHING_WRITRBACK_KMSG
	tristate "Nothing kernel writeback driver"
	default n
	help
		The driver logs power-on to system_stage kmsg log.
		So it doesn't log any customer info.
		When the device is stuck. It can help us debug.
		Check the /sys/devices/virtual/NT/NT_reserve_kernel_log/boot_stage_systemserver is exist.

config NOTHING_CHECK_PARTS
	tristate "Nothing check partitions status"
	default n
	help
		enable: echo fec_decode_rsb 1 > proc/nt_check_partitions/enable
		disable: echo fec_decode_rsb 0 > proc/nt_check_partitions/enable
		status: cat proc/nt_check_partitions/result

config NOTHING_TASK_MEMINFO
	tristate "Nothing show all task memory info driver"
	default n
	help
		cat /proc/nt_meminfo/show_all_tasks will show all task meminfo

config NOTHING_DISK_USAGE
	tristate "Nothing show all file size module"
	default n
	help
		Detect malicious files and prevent them from encroaching on disk space

config NOTHING_TASK_INFO
	tristate "Nothing show all task info driver"
	default n
	help
		cat /proc/nt_taskinfo/show_all_tasks_id will show all task pid

config NOTHING_RESTART_HANDLER
	tristate "Nothing power-off function enhance"
	default n
	help
		store restart info into imem.

config NOTHING_ERROR_REPORT
	tristate "Nothing error report"
	default n
	help
		Add reporting to userspace for related errors in hardware components.

config NOTHING_SECURE_ELEMENT
	tristate "Nothing secure state"
	default n
	help
		This driver getting secure info from hw which setting up in early stage.
```

## drivers/nothing_thermal/Kconfig
```kconfig
#
# Generic thermal sysfs drivers configuration
#

config NOTHING_VIRTUAL_NTC
	  tristate "Virtual NTC driver"
	  default n
	  help
	    Provide the thermal zones for virtual NTCs.
```

## vendor/qcom/opensource/audio-kernel/asoc/codecs/tfa98xx/Kconfig
```kconfig
config SND_SOC_TFA98XX
	bool "Support Goodix smartpa driver"
	depends on I2C = y && REGMAP = y
	default y
	help
	  Select this option to enable support for Goodix smartpa driver tfa98xx
```

## vendor/qcom/opensource/camera-kernel/crow_defconfig
```kconfig
CONFIG_SPECTRA_ISP=y
CONFIG_SPECTRA_ICP=y
CONFIG_SPECTRA_TFE=y
CONFIG_SPECTRA_JPEG=y
CONFIG_SPECTRA_CRE=y
CONFIG_SPECTRA_SENSOR=y
CONFIG_INTERCONNECT_QCOM=y
```

## vendor/qcom/opensource/camera-kernel/volcano_defconfig
```kconfig
CONFIG_SPECTRA_ISP=y
CONFIG_SPECTRA_ICP=y
CONFIG_SPECTRA_TFE=y
CONFIG_SPECTRA_CRE=y
CONFIG_SPECTRA_SENSOR=y
CONFIG_INTERCONNECT_QCOM=y
CONFIG_CSF_2_5_SECURE_CAMERA=y
```
