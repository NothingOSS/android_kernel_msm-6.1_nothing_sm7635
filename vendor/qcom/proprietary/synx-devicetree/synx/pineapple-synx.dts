/dts-v1/;
/plugin/;

#include <dt-bindings/soc/qcom,ipcc.h>
#include <dt-bindings/interrupt-controller/arm-gic.h>
#include "pineapple-synx.dtsi"

/ {
	model = "Qualcomm Technologies, Inc. Pineapple";
	compatible = "qcom,pineapple";
	qcom,msm-id = <557 0x10000>, <557 0x20000>, <577 0x10000>, <577 0x20000>, <614 0x10000>, <632 0x10000>, <642 0x10000>, <643 0x10000>, <682 0x10000>, <682 0x20000>;
	qcom,board-id = <0 0>;
};
