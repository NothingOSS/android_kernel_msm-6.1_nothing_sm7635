/dts-v1/;
/plugin/;

#include "trustedvm-cliffs-sde.dtsi"
#include "trustedvm-cliffs-sde-display-cdp.dtsi"

/ {
	model = "Qualcomm Technologies, Inc. Cliffs SVM CDP";
	compatible = "qcom,cliffs-cdp", "qcom,cliffs", "qcom,cdp";
	qcom,msm-id = <614 0x10000>, <632 0x10000>, <642 0x10000>, <643 0x10000>;
	qcom,board-id = <1 0>, <21 0>, <21 2>;
};
