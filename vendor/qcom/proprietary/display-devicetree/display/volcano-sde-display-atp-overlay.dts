/dts-v1/;
/plugin/;

#include "volcano-sde-display-atp.dtsi"

/ {
	model = "Qualcomm Technologies, Inc. Volcano ATP";
	compatible = "qcom,volcano-atp", "qcom,volcano", "qcom,volcanop-atp", "qcom,volcanop", "qcom,atp";
	qcom,msm-id = <636 0x10000>, <640 0x10000>, <641 0x10000>,
			<0x4000291 0x10000>, <0x4000292 0x10000>,
			<0x8000291 0x10000>, <0x8000292 0x10000>,
			<0xC000291 0x10000>, <0xC000292 0x10000>,
			<0x10000291 0x10000>, <0x10000292 0x10000>;
	qcom,board-id = <33 0>;
};
