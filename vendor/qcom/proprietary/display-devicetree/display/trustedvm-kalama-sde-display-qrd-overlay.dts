/dts-v1/;
/plugin/;

#include "trustedvm-kalama-sde.dtsi"
#include "trustedvm-kalama-sde-display-qrd.dtsi"

/ {
	model = "Qualcomm Technologies, Inc. Kalama QRD - TrustedVM";
	compatible = "qcom,kalama-qrd", "qcom,kalama", "qcom,qrd";
	qcom,msm-id = <519 0x10000>, <536 0x10000>, <519 0x20000>, <536 0x20000>;
	qcom,board-id = <0x1000B 0>, <0x2000B 0>;
};
