/dts-v1/;
/plugin/;

#include "trustedvm-cliffs-sde.dtsi"
#include "trustedvm-cliffs-sde-display-mtp.dtsi"

/ {
	model = "Qualcomm Technologies, Inc. Cliffs SVM MTP";
	compatible = "qcom,cliffs-mtp", "qcom,cliffs", "qcom,mtp";
	qcom,msm-id = <614 0x10000>, <632 0x10000>, <642 0x10000>, <643 0x10000>;
	qcom,board-id = <8 0>, <8 1>, <8 2>, <8 3>, <8 4>;
};
