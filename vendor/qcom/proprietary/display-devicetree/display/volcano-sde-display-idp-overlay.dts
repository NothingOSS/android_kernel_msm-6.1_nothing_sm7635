/dts-v1/;
/plugin/;

#include "volcano-sde-display-idp.dtsi"

/ {
	model = "Qualcomm Technologies, Inc. Volcano IDP";
	compatible = "qcom,volcano-idp", "qcom,volcano", "qcom,volcanop-idp", "qcom,volcanop", "qcom,idp";
	qcom,msm-id = <636 0x10000>, <640 0x10000>, <641 0x10000>,
			<0x4000291 0x10000>, <0x4000292 0x10000>,
			<0x8000291 0x10000>, <0x8000292 0x10000>,
			<0xC000291 0x10000>, <0xC000292 0x10000>,
			<0x10000291 0x10000>, <0x10000292 0x10000>;
	qcom,board-id = <34 0>;
};
