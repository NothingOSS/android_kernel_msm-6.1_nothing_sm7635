/dts-v1/;
/plugin/;

#include "sa8155-adp-star-display.dtsi"

/ {
	model = "ADP-AIR";
	compatible = "qcom,sa8155-v2-adp-air", "qcom,sa8155", "qcom,adp-air";
	qcom,board-id = <0 0>;
	qcom,msm-id = <339 0x10000>, <339 0x20000>,
			<362 0x10000>, <362 0x20000>,
			<367 0x10000>, <367 0x20000>;
};
