/dts-v1/;
/plugin/;

#include "trustedvm-volcano-sde.dtsi"
#include "trustedvm-volcano-sde-display-idp.dtsi"

/ {
	model = "Qualcomm Technologies, Inc. Volcano SVM IDP";
	compatible = "qcom,volcano-idp", "qcom,volcano", "qcom,idp";
	qcom,msm-id = <636 0x10000>, <640 0x10000>, <641 0x10000>,
			<657 0x10000>, <658 0x10000>;
	qcom,board-id = <34 0>, <34 1>;
};
