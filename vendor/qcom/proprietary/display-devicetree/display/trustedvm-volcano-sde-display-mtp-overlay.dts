/dts-v1/;
/plugin/;

#include "trustedvm-volcano-sde.dtsi"
#include "trustedvm-volcano-sde-display-mtp.dtsi"

/ {
	model = "Qualcomm Technologies, Inc. Volcano SVM MTP";
	compatible = "qcom,volcano-mtp", "qcom,volcano", "qcom,mtp";
	qcom,msm-id = <636 0x10000>, <640 0x10000>, <641 0x10000>,
			<657 0x10000>, <658 0x10000>;
	qcom,board-id = <8 0>, <8 1>, <8 2>, <8 3>, <8 4>,
			<8 5>, <8 6>;
};
