/dts-v1/;
/plugin/;

#include "cliffs-sde-display-mtp.dtsi"

/ {
	model = "Qualcomm Technologies, Inc. Cliffs ATP";
	compatible = "qcom,cliffs-atp", "qcom,cliffs", "qcom,atp";
	qcom,msm-id = <614 0x10000>, <632 0x10000>,  <642 0x10000>, <643 0x10000>;
	qcom,board-id = <33 0>;
};
