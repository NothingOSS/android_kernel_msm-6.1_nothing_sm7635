/dts-v1/;
/plugin/;

#include "pineapple-sde-display-mtp.dtsi"

/ {
	model = "Qualcomm Technologies, Inc. Pineapple ATP";
	compatible = "qcom,pineapple-atp", "qcom,pineapple", "qcom,pineapplep-atp", "qcom,pineapplep", "qcom,atp";
	qcom,msm-id = <557 0x10000>, <557 0x20000>, <577 0x10000>, <577 0x20000>,
			<682 0x10000>, <682 0x20000>;
	qcom,board-id = <0x10021 0>;
};
