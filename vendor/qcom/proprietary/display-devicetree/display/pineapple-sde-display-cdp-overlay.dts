/dts-v1/;
/plugin/;

#include "pineapple-sde-display-cdp.dtsi"

/ {
	model = "Qualcomm Technologies, Inc. Pineapple CDP";
	compatible = "qcom,pineapple-cdp", "qcom,pineapple", "qcom,pineapplep-cdp", "qcom,pineapplep", "qcom,cdp";
	qcom,msm-id = <557 0x10000>, <557 0x20000>, <577 0x10000>, <577 0x20000>,
			<682 0x10000>, <682 0x20000>;
	qcom,board-id = <0x1 0>, <0x01000001 0>;
};
