/dts-v1/;
/plugin/;

#include "trustedvm-volcano-sde.dtsi"
#include "trustedvm-volcano-sde-display-rumi.dtsi"

/ {
	model = "Qualcomm Technologies, Inc. Volcano SVM RUMI";
	compatible = "qcom,volcano-rumi", "qcom,volcano", "qcom,rumi";
	qcom,msm-id = <636 0x10000>;
	qcom,board-id = <15 0>;
};
