/dts-v1/;
/plugin/;

#include "trustedvm-kalama-sde.dtsi"
#include "trustedvm-kalama-sde-display-cdp.dtsi"

/ {
	model = "Qualcomm Technologies, Inc. Kalama CDP ST54K NFC - TrustedVM";
	compatible = "qcom,kalama-cdp", "qcom,kalama", "qcom,cdp";
	qcom,msm-id = <519 0x10000>, <536 0x10000>, <519 0x20000>, <536 0x20000>;
	qcom,board-id = <0x02010001 0>;
};
