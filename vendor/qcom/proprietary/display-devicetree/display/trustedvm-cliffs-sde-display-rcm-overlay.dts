/dts-v1/;
/plugin/;

#include "trustedvm-cliffs-sde.dtsi"
#include "trustedvm-cliffs-sde-display-rcm.dtsi"

/ {
	model = "Qualcomm Technologies, Inc. Cliffs SVM RCM";
	compatible = "qcom,cliffs-rcm", "qcom,cliffs", "qcom,rcm";
	qcom,msm-id = <614 0x10000>, <632 0x10000>, <642 0x10000>, <643 0x10000>;
	qcom,board-id = <21 1>, <21 3>;
};
