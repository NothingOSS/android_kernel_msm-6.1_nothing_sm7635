/dts-v1/;
/plugin/;

#include "cliffs-sde-display-rcm.dtsi"

/ {
	model = "Qualcomm Technologies, Inc. Cliffs RCM QHD+";
	compatible = "qcom,cliffs-rcm", "qcom,cliffs", "qcom,rcm";
	qcom,msm-id = <614 0x10000>, <632 0x10000>, <642 0x10000>, <643 0x10000>;
	qcom,board-id = <21 1>, <21 3>;
};
