/dts-v1/;
/plugin/;

#include "trustedvm-kalama-sde.dtsi"
#include "trustedvm-kalama-sde-display-mtp.dtsi"

/ {
	model = "Qualcomm Technologies, Inc. Kalama ATP - TrustedVM";
	compatible = "qcom,kalama-atp", "qcom,kalama", "qcom,atp";
	qcom,msm-id = <519 0x10000>, <536 0x10000>, <519 0x20000>, <536 0x20000>;
	qcom,board-id = <0x10021 0>;
};
