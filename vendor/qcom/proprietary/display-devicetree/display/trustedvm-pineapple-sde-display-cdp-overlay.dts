/dts-v1/;
/plugin/;

#include "trustedvm-pineapple-sde.dtsi"
#include "trustedvm-pineapple-sde-display-cdp.dtsi"

/ {
	model = "Qualcomm Technologies, Inc. Pineapple CDP - TrustedVM";
	compatible = "qcom,pineapple-cdp", "qcom,pineapple", "qcom,pineapplep-cdp", "qcom,pineapplep", "qcom,cdp";
	qcom,msm-id = <557 0x10000>, <557 0x20000>, <577 0x10000>, <577 0x20000>;
	qcom,board-id = <0x10001 0>;
};
