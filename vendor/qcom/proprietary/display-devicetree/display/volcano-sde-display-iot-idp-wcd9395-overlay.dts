/dts-v1/;
/plugin/;

#include "volcano-sde-display-iot-mtp-wcd9395.dtsi"

/ {
	model = "Qualcomm Technologies, Inc. Volcano6I IDP + WCD9395";
	compatible = "qcom,volcano-idp", "qcom,volcano", "qcom,volcanop-idp", "qcom,volcanop", "qcom,idp";
	qcom,msm-id = <0x4000291 0x10000>, <0x4000292 0x10000>,
			<0x8000291 0x10000>, <0x8000292 0x10000>,
			<0xC000291 0x10000>, <0xC000292 0x10000>,
			<0x10000291 0x10000>, <0x10000292 0x10000>;
	qcom,board-id = <34 2>, <34 3>;
};
