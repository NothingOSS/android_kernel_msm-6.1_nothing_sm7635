/dts-v1/;
/plugin/;

#include "trustedvm-pineapple-sde.dtsi"
#include "trustedvm-pineapple-sde-display-qrd.dtsi"

/ {
	model = "Qualcomm Technologies, Inc. Pineapple QRD - TrustedVM";
	compatible = "qcom,pineapple-qrd", "qcom,pineapple", "qcom,pineapplep-qrd", "qcom,pineapplep", "qcom,qrd";
	qcom,msm-id = <557 0x10000>, <557 0x20000>, <577 0x10000>, <577 0x20000>,
			<682 0x10000>, <682 0x20000>;
	qcom,board-id = <0x1000B 0>, <0x5000B 0>, <0xB 0>;
};
