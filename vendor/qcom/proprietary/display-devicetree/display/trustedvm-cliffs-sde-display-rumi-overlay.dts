/dts-v1/;
/plugin/;

#include "trustedvm-cliffs-sde.dtsi"
#include "trustedvm-cliffs-sde-display-rumi.dtsi"

/ {
	model = "Qualcomm Technologies, Inc. Cliffs SVM RUMI";
	compatible = "qcom,cliffs-rumi", "qcom,cliffs", "qcom,rumi";
	qcom,msm-id = <614 0x10000>, <632 0x10000>;
	qcom,board-id = <15 0>;
};
