/dts-v1/;
/plugin/;

#include "trustedvm-volcano-sde.dtsi"
#include "trustedvm-volcano-sde-display-atp.dtsi"

/ {
	model = "Qualcomm Technologies, Inc. Volcano SVM ATP";
	compatible = "qcom,volcano-atp", "qcom,volcano", "qcom,atp";
	qcom,msm-id = <636 0x10000>, <640 0x10000>, <641 0x10000>,
			<657 0x10000>, <658 0x10000>;
	qcom,board-id = <33 0>;
};
