/dts-v1/;
/plugin/;

#include "volcano-sde-display-rumi.dtsi"

/ {
	model = "Qualcomm Technologies, Inc. Volcano RUMI";
	compatible = "qcom,volcano-rumi", "qcom,volcano", "qcom,rumi";
	qcom,msm-id = <636 0x10000>;
	qcom,board-id = <15 0>;
};
