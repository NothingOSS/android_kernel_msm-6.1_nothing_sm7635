/dts-v1/;
/plugin/;

#include "pitti-sde-display-idp-pmiv0104.dtsi"

/ {
	model = "Qualcomm Technologies, Inc. Pitti IDP-pmiv0104";
	compatible = "qcom,pitti-idp", "qcom,pitti", "qcom,idp";
	qcom,msm-id = <623 0x10000>;
	qcom,board-id = <34 0>, <34 0x600>, <34 2>;
	qcom,pmic-id-size = <9>;
	qcom,pmic-id = <0x0 0x0 0x0 0x0 0x0 0x0 0x0 0x0 0x59>;
};
