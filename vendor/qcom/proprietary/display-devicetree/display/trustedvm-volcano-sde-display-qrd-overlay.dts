/dts-v1/;
/plugin/;

#include "trustedvm-volcano-sde.dtsi"
#include "trustedvm-volcano-sde-display-qrd.dtsi"

/ {
	model = "Qualcomm Technologies, Inc. Volcano SVM QRD";
	compatible = "qcom,volcano-qrd", "qcom,volcano", "qcom,qrd";
	qcom,msm-id = <636 0x10000>, <640 0x10000>, <641 0x10000>,
			<657 0x10000>, <658 0x10000>;
	qcom,board-id = <11 0>, <11 1>;
};
