/dts-v1/;
/plugin/;

#include "trustedvm-volcano-sde.dtsi"
#include "trustedvm-volcano-sde-display-mtp.dtsi"

/ {
	model = "Qualcomm Technologies, Inc. Volcano6I IDP";
	compatible = "qcom,volcano-idp", "qcom,volcano", "qcom,idp";
	qcom,msm-id = <657 0x10000>, <658 0x10000>;
	qcom,board-id = <34 2>, <34 3>;
};
