/dts-v1/;
/plugin/;

#include <dt-bindings/clock/qcom,aop-qmp.h>
#include <dt-bindings/clock/qcom,gcc-volcano.h>
#include <dt-bindings/clock/qcom,gpucc-volcano.h>
#include <dt-bindings/clock/qcom,rpmh.h>
#include <dt-bindings/interconnect/qcom,volcano.h>
#include <dt-bindings/interrupt-controller/arm-gic.h>
#include <dt-bindings/regulator/qcom,rpmh-regulator-levels.h>
#include <dt-bindings/interrupt-controller/arm-gic.h>

#include "volcano-gpu.dtsi"
#include "volcano6-gpu-pwrlevels.dtsi"

/ {
	model = "Qualcomm Technologies, Inc. Volcano6P SoC";
	compatible = "qcom,volcanop";
	qcom,msm-id = <641 0x10000>;
	qcom,board-id = <0 0>;
};
