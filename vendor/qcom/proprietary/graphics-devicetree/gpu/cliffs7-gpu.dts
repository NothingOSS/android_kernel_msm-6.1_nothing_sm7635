/dts-v1/;
/plugin/;

#include <dt-bindings/clock/qcom,aop-qmp.h>
#include <dt-bindings/clock/qcom,gcc-cliffs.h>
#include <dt-bindings/clock/qcom,gpucc-cliffs.h>
#include <dt-bindings/clock/qcom,rpmh.h>
#include <dt-bindings/interconnect/qcom,cliffs.h>
#include <dt-bindings/interrupt-controller/arm-gic.h>
#include <dt-bindings/regulator/qcom,rpmh-regulator-levels.h>

#include "cliffs7-gpu.dtsi"
#include "cliffs7-gpu-pwrlevels.dtsi"

/ {
	model = "Qualcomm Technologies, Inc. Cliffs 7";
	compatible = "qcom,cliffs", "qcom,cliffsp";
	qcom,msm-id = <632 0x10000>, <643 0x10000>;
	qcom,board-id = <0 0>;
};
