/dts-v1/;
/plugin/;

#include <dt-bindings/interrupt-controller/arm-gic.h>
#include <dt-bindings/clock/qcom,rpmcc.h>
#include <dt-bindings/clock/qcom,dispcc-khaje.h>
#include <dt-bindings/clock/qcom,gcc-khaje.h>
#include <dt-bindings/clock/qcom,gpucc-khaje.h>
#include <dt-bindings/spmi/spmi.h>
#include <dt-bindings/regulator/qcom,rpmh-regulator-levels.h>
#include <dt-bindings/interconnect/qcom,bengal.h>
#include <dt-bindings/soc/qcom,dcc_v2.h>

#include "khaje-gpu.dtsi"

/ {
	model = "Qualcomm Technologies, Inc. Khaje SoC";
	compatible = "qcom,khaje", "qcom,khaje-qrd",
			"qcom,khaje-atp", "qcom,khaje-idp";
	qcom,msm-id = <518 0x10000>, <586 0x10000>;
	qcom,board-id = <0 0>;
};

