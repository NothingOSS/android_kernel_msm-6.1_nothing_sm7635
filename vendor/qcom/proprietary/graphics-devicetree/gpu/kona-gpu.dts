/dts-v1/;
/plugin/;

#include <dt-bindings/regulator/qcom,rpmh-regulator-levels.h>
#include <dt-bindings/clock/qcom,gpucc-sm8250.h>
#include <dt-bindings/clock/qcom,gcc-sm8250.h>
#include <dt-bindings/clock/qcom,aop-qmp.h>
#include <dt-bindings/interconnect/qcom,kona.h>
#include <dt-bindings/interrupt-controller/irq.h>
#include "kona-gpu.dtsi"

/{
	model = "Qualcomm Technologies, Inc. Kona-iot";
	compatible = "qcom,kona", "qcom,kona-iot";
	qcom,msm-id = <356 0x10000>, <455 0x0>, <481 0x0>,
			<496 0x0>, <598 0x0>, <599 0x0>;
	qcom,board-id = <0 0>;
};
