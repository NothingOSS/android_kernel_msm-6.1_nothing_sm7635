/dts-v1/;
/plugin/;

#include <dt-bindings/regulator/qcom,rpmh-regulator-levels.h>
#include <dt-bindings/clock/qcom,gpucc-trinket.h>
#include <dt-bindings/clock/qcom,gcc-trinket.h>
#include <dt-bindings/clock/qcom,aop-qmp.h>
#include <dt-bindings/interconnect/qcom,trinket.h>
#include <dt-bindings/interrupt-controller/irq.h>

#include "trinket-gpu.dtsi"

/ {
	model = "Qualcomm Technologies, Inc. TRINKETP";
	compatible = "qcom,trinketp-iot";
	qcom,msm-id = <468 0x0>;
	qcom,board-id = <0 0>;
};
