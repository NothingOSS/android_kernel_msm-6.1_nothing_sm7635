/dts-v1/;
/plugin/;

#include <dt-bindings/clock/qcom,gcc-pineapple.h>
#include <dt-bindings/clock/qcom,camcc-pineapple.h>
#include <dt-bindings/interconnect/qcom,pineapple.h>
#include <dt-bindings/interrupt-controller/arm-gic.h>
#include <dt-bindings/regulator/qcom,rpmh-regulator-levels.h>

#include "pineapple-camera-v2.dtsi"

/ {
	model = "Qualcomm Technologies, Inc. Pineapple SoC";
	compatible = "qcom,pineapple";
	qcom,msm-id = <557 0x20000>, <577 0x20000>;
	qcom,board-id = <0 0>;
};
