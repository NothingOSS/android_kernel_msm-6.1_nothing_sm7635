/dts-v1/;
/plugin/;

#include <dt-bindings/clock/qcom,gcc-volcano.h>
#include <dt-bindings/clock/qcom,camcc-volcano.h>
#include <dt-bindings/interconnect/qcom,volcano.h>
#include <dt-bindings/interrupt-controller/arm-gic.h>
#include <dt-bindings/regulator/qcom,rpmh-regulator-levels.h>

#include "volcano-camera-sensor-idp.dtsi"
/ {
	model = "Qualcomm Technologies, Inc. Volcano MTP";
	compatible = "qcom,volcano-mtp", "qcom,volcano", "qcom,volcanop-mtp", "qcom,volcanop", "qcom,mtp";
	qcom,msm-id = <636 0x10000>, <640 0x10000>, <641 0x10000>,
			<0x4000291 0x10000>, <0x4000292 0x10000>,
			<0x8000291 0x10000>, <0x8000292 0x10000>,
			<0xc000291 0x10000>, <0xc000292 0x10000>,
			<0x10000291 0x10000>, <0x10000292 0x10000>;
	qcom,board-id = <8 0>, <8 1>, <8 2>, <8 3>, <8 4>, <8 5>, <8 6>, <8 7>, <8 8>;
};
