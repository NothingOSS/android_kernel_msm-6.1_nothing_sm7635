/dts-v1/;
/plugin/;

#include <dt-bindings/clock/qcom,gcc-volcano.h>
#include <dt-bindings/clock/qcom,camcc-volcano.h>
#include <dt-bindings/interconnect/qcom,volcano.h>
#include <dt-bindings/interrupt-controller/arm-gic.h>
#include <dt-bindings/regulator/qcom,rpmh-regulator-levels.h>

#include "arcanine-pro-camera-sensor.dtsi"
/ {
	model = "Qualcomm Technologies, Inc. Volcano QRD Pro";
	compatible = "qcom,volcano-qrd", "qcom,volcano", "qcom,volcanop-qrd", "qcom,volcanop", "qcom,qrd";
	qcom,msm-id = <636 0x10000>, <640 0x10000>, <641 0x10000>,
			<657 0x10000>, <658 0x10000>;
	qcom,board-id = <11 0>, <11 1>;

	qcom,oem-id = <2>;
};
