/dts-v1/;
/plugin/;

#include <dt-bindings/clock/qcom,gcc-volcano.h>
#include <dt-bindings/clock/qcom,camcc-volcano.h>
#include <dt-bindings/interconnect/qcom,volcano.h>
#include <dt-bindings/interrupt-controller/arm-gic.h>
#include <dt-bindings/regulator/qcom,rpmh-regulator-levels.h>

#include "volcano-camera-qrd.dtsi"
/ {
	model = "Qualcomm Technologies, Inc. Volcano QRD";
	compatible = "qcom,volcano-qrd", "qcom,volcano", "qcom,volcanop-qrd", "qcom,volcanop", "qcom,qrd";
	qcom,msm-id = <636 0x10000>, <640 0x10000>, <641 0x10000>;
	qcom,board-id = <0 0>;
};
