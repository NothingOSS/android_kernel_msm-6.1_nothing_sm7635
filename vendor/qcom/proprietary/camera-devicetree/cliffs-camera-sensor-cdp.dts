/dts-v1/;
/plugin/;

#include <dt-bindings/clock/qcom,gcc-cliffs.h>
#include <dt-bindings/clock/qcom,camcc-cliffs.h>
#include <dt-bindings/interconnect/qcom,cliffs.h>
#include <dt-bindings/interrupt-controller/arm-gic.h>
#include <dt-bindings/regulator/qcom,rpmh-regulator-levels.h>

#include "cliffs-camera-sensor-cdp.dtsi"
/ {
	model = "Qualcomm Technologies, Inc. Cliffs CDP/RCM";
	compatible = "qcom,cliffs-cdp", "qcom,cliffs", "qcom,cdp", "qcom,rcm", "qcom,cliffs-rcm";
	qcom,msm-id = <614 0x10000>, <632 0x10000>, <642 0x10000>, <643 0x10000>;
	qcom,board-id = <1 0>, <21 0>, <21 1>, <21 2>, <21 3>;
};
