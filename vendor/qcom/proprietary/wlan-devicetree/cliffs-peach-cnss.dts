/dts-v1/;
/plugin/;

#include "cliffs-peach-cnss.dtsi"

/ {
	model = "Qualcomm Technologies, Inc. Cliffs SoCs";
	compatible = "qcom,cliffs";
	qcom,msm-id = <614 0x10000>, <632 0x10000>, <642 0x10000>, <643 0x10000>;
	qcom,board-id = <8 3>, <8 4>;
};
