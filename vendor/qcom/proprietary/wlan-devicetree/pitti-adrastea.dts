/dts-v1/;
/plugin/;

#include "pitti-adrastea.dtsi"

/ {
	model = "Qualcomm Technologies, Inc. Pitti SoC";
	compatible = "qcom,pitti";
	qcom,msm-id = <623 0x10000>;
	qcom,board-id = <0 0>, <0 0x501>, <0 0x600>;
};
