/dts-v1/;
/plugin/;

#include "niobe-kiwi-cnss.dtsi"

/ {
	model = "Qualcomm Technologies, Inc. Niobe SoCs";
	compatible = "qcom,niobe";
	qcom,msm-id = <629 0x10000>, <652 0x10000>;
	qcom,board-id = <0x10021 0>, <0x10022 0>, <0x10022 1>, <0x10026 0>;
};
