/dts-v1/;
/plugin/;

#include "bengal-cnss.dtsi"

/ {
	model = "Qualcomm Technologies, Inc. Bengal SoC";
	compatible = "qcom,bengal";
	qcom,msm-id = <417 0x10000>, <444 0x10000>;
	qcom,board-id = <0 0>;
};
