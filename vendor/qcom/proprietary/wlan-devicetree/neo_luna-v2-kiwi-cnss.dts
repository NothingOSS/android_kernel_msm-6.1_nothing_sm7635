/dts-v1/;
/plugin/;

#include "neo_luna-v2-kiwi-cnss.dtsi"

/ {
	model = "Qualcomm Technologies, Inc. NEO IDP HMT";
	compatible = "qcom,neo-idp", "qcom,neo", "qcom,idp";
	qcom,msm-id = <579 0x10000>;
	qcom,board-id = <34 1>, <34 2>, <34 2>, <34 5>;
};
