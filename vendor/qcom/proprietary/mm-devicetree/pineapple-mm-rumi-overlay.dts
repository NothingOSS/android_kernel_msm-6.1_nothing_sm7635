/dts-v1/;
/plugin/;

#include "hw_fence/pineapple-hw-fence.dtsi"

/ {
	model = "Qualcomm Technologies, Inc. Pineapple RUMI";
	compatible = "qcom,pineapple-rumi", "qcom,pineapple", "qcom,rumi";
	qcom,msm-id = <557 0x10000>, <557 0x20000>;
	qcom,board-id = <15 0>;
};
