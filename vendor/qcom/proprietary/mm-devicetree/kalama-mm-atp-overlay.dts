/dts-v1/;
/plugin/;

#include "hw_fence/kalama-hw-fence.dtsi"

/ {
	model = "Qualcomm Technologies, Inc. Kalama ATP";
	compatible = "qcom,kalama-atp", "qcom,kalama", "qcom,atp";
	qcom,msm-id = <519 0x10000>, <536 0x10000>, <519 0x20000>, <536 0x20000>;
	qcom,board-id = <0x10021 0>;
};
