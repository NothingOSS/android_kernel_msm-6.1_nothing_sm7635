/dts-v1/;
/plugin/;

#include "anorak61-kiwi-bt.dtsi"

/ {
	model = "Qualcomm Technologies, Inc. Anorak IDP HMT";
	compatible = "qcom,anorak-idp", "qcom,anorak", "qcom,idp", "qcom,anorakp-idp", "qcom,anorakp";
	qcom,msm-id = <549 0x10000>, <649 0x10000>;
	qcom,board-id = <0x10022 0x1>, <0x10022 0x3>, <0x10022 0x6>;
};
