/dts-v1/;
/plugin/;

#include "pineapple-aim500-kiwi-bt.dtsi"

/ {
	model = "Qualcomm Technologies, Inc. Pineapple AIM500";
	compatible = "qcom,pineapplep-hdk", "qcom,pineapplep", "qcom,hdk";
	qcom,msm-id = <577 0x10000>, <577 0x20000>, <682 0x10000>, <682 0x20000>;
	qcom,board-id = <0x1001f 1>, <0x1011f 1>;
};
