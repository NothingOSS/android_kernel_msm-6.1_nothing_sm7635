#include <dt-bindings/interconnect/qcom,waipio.h>

&bluetooth {
	status = "disabled";
};

&soc {
	bt_hmt: bt_wcn7850 {
		compatible = "qcom,wcn7850";
		pinctrl-names = "default";
		pinctrl-0 = <&bt_en_sleep>;
		qcom,bt-reset-gpio = <&tlmm 81 0>; /* BT_EN */
		qcom,wl-reset-gpio = <&tlmm 80 0>; /* WL_EN */
		qcom,bt-sw-ctrl-gpio = <&tlmm 82 0>; /* SW_CTRL */

		qcom,bt-vdd-aon-supply = <&S11B>;
		qcom,bt-vdd-dig-supply = <&S11B>;
		qcom,bt-vdd-rfa1-supply = <&S1C>;
		qcom,bt-vdd-rfa2-supply = <&S12B>;

		qcom,bt-vdd-aon-config = <950000 950000 0 1>;
		qcom,bt-vdd-dig-config = <950000 950000 0 1>;
		qcom,bt-vdd-rfa1-config = <1900000 1900000 0 1>;
		qcom,bt-vdd-rfa2-config = <1350000 1350000 0 1>;
	};
};
