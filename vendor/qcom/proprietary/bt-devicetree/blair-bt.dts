/dts-v1/;
/plugin/;

#include "blair-bt.dtsi"

/ {
	model = "Qualcomm Technologies, Inc. Blair SoC";
	compatible = "qcom,blair";
	qcom,msm-id = <507 0x10000>, <578 0x10000>;
	qcom,board-id = <0 0>;
};
