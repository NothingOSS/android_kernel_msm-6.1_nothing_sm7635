/dts-v1/;
/plugin/;

#include "cliffs-kiwi-bt.dtsi"

/ {
	model = "Qualcomm Technologies, Inc. Cliffs SoCs";
	compatible = "qcom,cliffs";
	qcom,msm-id = <614 0x10000>, <632 0x10000>, <642 0x10000>, <643 0x10000>;
	qcom,board-id = <33 0>, <8 1>, <8 2>, <21 2>, <21 3>;
};
