#include "pineapple-kiwi-bt.dtsi"

&bluetooth {
	status = "disabled";
};

&soc {
	bluetooth_no_ant_power: bt_kiwi_no_share_ant_power {
		compatible = "qcom,kiwi-no-share-ant-power";
		pinctrl-names = "bt_en_sleep";
		pinctrl-0 = <&bt_en_sleep>;
		/* List of GPIOs to be setup for interrupt wakeup capable*/
		mpm_wake_set_gpios = <18>;
		qcom,bt-reset-gpio = <&tlmm 17 0>; /* BT_EN */
		qcom,wl-reset-gpio = <&tlmm 16 0>; /* WL_EN */
		qcom,bt-sw-ctrl-gpio = <&tlmm 18 0>; /* SW_CTRL */
		mboxes = <&qmp_aop 0>;

		qcom,bt-vdd18-aon-supply  = <&L15B>; /* BT VDD1.8 AON */
		qcom,bt-vdd12-io-supply   = <&L3C>;  /* BT VDD1.2V IO */
		qcom,bt-vdd-dig-supply    = <&S3C>;  /* BT LDO*/
		qcom,bt-vdd-aon-supply    = <&S3C>;  /* BT AON LDO*/
		qcom,bt-vdd-rfaOp8-supply = <&S3C>;  /* BT RFAOp8 CMN LDO*/
		qcom,bt-vdd-rfa1-supply   = <&S1C>;  /* BT RFA1.2 LDO */
		qcom,bt-vdd-rfa2-supply   = <&S6C>;  /* BT RFA1.8 LDO */

		qcom,bt-vdd18-aon-config  = <1800000 1800000 0 1>;
		qcom,bt-vdd12-io-config   = <1200000 1200000 0 1>;
		qcom,bt-vdd-aon-config    = <916000 916000 0 1>;
		qcom,bt-vdd-dig-config    = <916000 916000 0 1>;
		qcom,bt-vdd-rfaOp8-config = <916000 916000 0 1>;
		qcom,bt-vdd-rfa1-config   = <1316000 1316000 0 1>;
		qcom,bt-vdd-rfa2-config   = <1864000 1864000 0 1>;
		qcom,pdc_init_table=
			"{class: wlan_pdc, ss: rf, res: s3c.v, upval: 916}",
			"{class: wlan_pdc, ss: rf, res: s3c.v, dwnval: 612}",
			"{class: wlan_pdc, ss: rf, res: s1c.v, upval: 1316}",
			"{class: wlan_pdc, ss: rf, res: s1c.v, dwnval: 944}",
			"{class: wlan_pdc, ss: rf, res: s6c.v, upval: 1864}",
			"{class: wlan_pdc, ss: rf, res: s6c.v, dwnval: 1820}";
	};
};

&fm_rtc6226 {
	status = "disabled";
};
