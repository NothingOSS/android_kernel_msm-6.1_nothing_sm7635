/dts-v1/;
/plugin/;

#include <dt-bindings/interrupt-controller/arm-gic.h>
#include <dt-bindings/soc/qcom,ipcc.h>
#include <dt-bindings/interconnect/qcom,volcano.h>
#include <dt-bindings/clock/qcom,gcc-volcano.h>
#include <dt-bindings/clock/qcom,rpmh.h>
#include "volcano-ipa.dtsi"

/{
    model = "Qualcomm Technologies, Inc. Volcano";
    compatible = "qcom,volcano";
    qcom,msm-id = <636 0x10000>, <640 0x10000>, <657 0x10000>, <0x10000291 0x10000>, <0xC000291 0x10000>, <0x8000291 0x10000>, <0x4000291 0x10000>;
    qcom,board-id = <0 0>;
};
