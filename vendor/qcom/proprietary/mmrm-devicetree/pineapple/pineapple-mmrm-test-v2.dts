/dts-v1/;
/plugin/;

#include <dt-bindings/clock/qcom,camcc-pineapple.h>
#include <dt-bindings/clock/qcom,videocc-pineapple.h>
#include <dt-bindings/clock/qcom,dispcc-pineapple.h>

#include "pineapple-mmrm-test-v2.dtsi"

/ {
	model = "Qualcomm Technologies, Inc. Pineapple SoC";
	compatible = "qcom,pineapple";
	qcom,msm-id = <557 0x20000>, <577 0x20000>;
	qcom,board-id = <0 0>; /* required by merge_dtbs.py */
};
