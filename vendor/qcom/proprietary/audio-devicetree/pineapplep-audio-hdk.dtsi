#include "pineapple-audio-qrd.dtsi"

&pineapple_snd {
	qcom,model = "pineapple-qrd-snd-card";

	qcom,msm-mbhc-usbc-audio-supported = <0>;
	qcom,msm-mbhc-hphl-swh = <1>;
	qcom,msm-mbhc-gnd-swh = <1>;
};

