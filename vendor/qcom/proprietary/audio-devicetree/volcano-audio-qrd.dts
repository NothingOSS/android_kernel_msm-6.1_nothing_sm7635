/dts-v1/;
/plugin/;

#include "volcano-audio-qrd.dtsi"

/ {
	model = "Qualcomm Technologies, Inc. volcano QRD";
	compatible = "qcom,volcano-qrd", "qcom,volcano", "qcom,qrd";
	qcom,msm-id = <636 0x10000>, <640 0x10000>, <641 0x10000>;
	qcom,board-id = <11 0>;
};
