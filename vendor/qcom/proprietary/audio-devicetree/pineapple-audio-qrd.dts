/dts-v1/;
/plugin/;

#include "pineapple-audio-qrd.dtsi"
 / {
	model = "Qualcomm Technologies, Inc. Pineapple QRD";
	compatible = "qcom,pineapple-qrd", "qcom,pineapple", "qcom,qrd";
	qcom,msm-id = <557 0x10000>, <557 0x20000>, <577 0x10000>, <577 0x20000>,
			<682 0x10000>, <682 0x20000>;
	qcom,board-id = <0x1000B 0>, <11 0>;
};
