/dts-v1/;
/plugin/;

#include "pineapple-audio-rumi.dtsi"
 / {
	model = "Qualcomm Technologies, Inc. Pineapple RUMI";
	compatible = "qcom,pineapple-rumi", "qcom,pineapple", "qcom,rumi";
	qcom,msm-id = <557 0x10000>, <557 0x20000>, <577 0x10000>, <577 0x20000>;
	qcom,board-id = <15 0>;
};
