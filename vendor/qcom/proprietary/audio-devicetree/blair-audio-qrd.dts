/dts-v1/;
/plugin/;

#include "blair-audio-qrd.dtsi"

/ {
	model = "Qualcomm Technologies, Inc. Blair QRD";
	compatible = "qcom,blair-qrd", "qcom,blair", "qcom,qrd";
	qcom,msm-id = <507 0x10000>, <578 0x10000>, <454 0x10000>, <472 0x10000>;
	qcom,board-id = <0x1000B 0>, <0xb 0>;
};