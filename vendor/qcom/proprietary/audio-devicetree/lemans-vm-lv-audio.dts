/dts-v1/;
/plugin/;

#include <dt-bindings/interrupt-controller/arm-gic.h>
#include <dt-bindings/regulator/qcom,rpmh-regulator-levels.h>

#include "lemans-vm-audio.dtsi"

/ {
	model = "Qualcomm Technologies, Inc. Lemans Single LV Guest Virtual Machine";
	compatible = "qcom,lemans", "qcom,quinvm";
	qcom,msm-id = <532 0x20000>;
	qcom,board-id = <0x0 0x1000002>, <0x0 0x2000002>;
};
