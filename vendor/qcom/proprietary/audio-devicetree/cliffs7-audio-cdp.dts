/dts-v1/;
/plugin/;

#include "cliffs7-audio-cdp.dtsi"
 / {
	model = "Qualcomm Technologies, Inc. Cliffs CDP";
	compatible = "qcom,cliffs-cdp", "qcom,cliffs", "qcom,cdp";
	qcom,msm-id = <632 0x10000>, <643 0x10000>;
	qcom,board-id = <1 0>;
};
