#include "blair-audio-overlay.dtsi"

&wsa881x_analog_reset_gpio {
	compatible = "qcom,msm-cdc-pinctrl";
	pinctrl-names = "aud_active", "aud_sleep";
	pinctrl-0 = <&spkr_1_sd_n_active>;
	pinctrl-1 = <&spkr_1_sd_n_sleep>;
};

&wsa881x_i2c_e {
	status = "ok";
	cdc-vdd-1p8-supply = <&L9A>;
	compatible = "qcom,wsa881x-i2c-codec";
	reg = <0x0e>;
	clock-names = "wsa_mclk";
	clocks = <&wsa881x_analog_clk 0>;
	qcom,wsa-analog-clk-gpio = <&wsa881x_analog_clk_gpio>;
	qcom,wsa-analog-reset-gpio = <&wsa881x_analog_reset_gpio>;
};

&holi_snd {
	qcom,model = "blair-qrd-snd-card";
	qcom,msm-mi2s-master = <1>, <1>, <1>, <1>;
	qcom,wcn-btfm = <1>;
	qcom,audio-routing =
		"AMIC1", "Analog Mic1",
		"AMIC1", "MIC BIAS1",
		"AMIC2", "Analog Mic2",
		"AMIC2", "MIC BIAS2",
		"AMIC3", "Analog Mic3",
		"AMIC3", "MIC BIAS3",
		"AMIC4", "Analog Mic4",
		"AMIC4", "MIC BIAS3",
		"TX DMIC0", "Digital Mic0",
		"TX DMIC0", "MIC BIAS1",
		"TX DMIC1", "Digital Mic1",
		"TX DMIC1", "MIC BIAS1",
		"TX DMIC2", "Digital Mic2",
		"TX DMIC2", "MIC BIAS3",
		"TX DMIC3", "Digital Mic3",
		"TX DMIC3", "MIC BIAS3",
		"IN1_HPHL", "HPHL_OUT",
		"IN2_HPHR", "HPHR_OUT",
		"IN3_AUX", "AUX_OUT",
		"RX_TX DEC0_INP", "TX DEC0 MUX",
		"RX_TX DEC1_INP", "TX DEC1 MUX",
		"RX_TX DEC2_INP", "TX DEC2 MUX",
		"RX_TX DEC3_INP", "TX DEC3 MUX",
		"SpkrMono WSA_IN", "AUX",
		"TX SWR_INPUT", "WCD_TX_OUTPUT",
		"VA SWR_INPUT", "VA_SWR_CLK",
		"VA SWR_INPUT", "WCD_TX_OUTPUT",
		"VA_AIF1 CAP", "VA_SWR_CLK",
		"VA_AIF2 CAP", "VA_SWR_CLK",
		"VA_AIF3 CAP", "VA_SWR_CLK",
		"VA DMIC0", "Digital Mic0",
		"VA DMIC1", "Digital Mic1",
		"VA DMIC2", "Digital Mic2",
		"VA DMIC3", "Digital Mic3",
		"VA DMIC4", "Digital Mic4",
		"VA DMIC5", "Digital Mic5",
		"VA DMIC0", "VA MIC BIAS1",
		"VA DMIC1", "VA MIC BIAS1",
		"VA DMIC2", "VA MIC BIAS3",
		"VA DMIC3", "VA MIC BIAS3";
	qcom,msm-mbhc-usbc-audio-supported = <0>;
	qcom,msm-mbhc-hphl-swh = <1>;
	qcom,msm-mbhc-gnd-swh = <1>;
	qcom,cdc-dmic01-gpios = <&cdc_dmic01_gpios>;
	qcom,cdc-dmic23-gpios = <&cdc_dmic23_gpios>;

	nvmem-cells = <&adsp_variant>;
	nvmem-cell-names = "adsp_variant";

	asoc-codec  = <&stub_codec>, <&bolero_cdc>,
		  <&wcd937x_codec>, <&wsa881x_i2c_e>;
	asoc-codec-names = "msm-stub-codec.1", "bolero-codec",
			   "wcd937x_codec", "wsa-codec0";
	qcom,wsa-max-devs = <1>;
	qcom,wsa-aux-dev-prefix = "SpkrMono";
	qcom,msm_audio_ssr_devs = <&audio_gpr>, <&lpi_tlmm>,
								<&bolero_cdc>;
};
