/dts-v1/;
/plugin/;

#include "volcano-audio-atp.dtsi"
/ {
	model = "Qualcomm Technologies, Inc. volcano ATP";
	compatible = "qcom,volcano-atp", "qcom,volcano", "qcom,atp";
	qcom,msm-id = <636 0x10000>, <640 0x10000>, <641 0x10000>;
	qcom,board-id = <33 0>;
};
