/dts-v1/;
/plugin/;

#include "cliffs7-audio-atp.dtsi"
 / {
	model = "Qualcomm Technologies, Inc. Cliffs ATP";
	compatible = "qcom,cliffs-atp", "qcom,cliffs", "qcom,atp";
	qcom,msm-id = <632 0x10000>, <643 0x10000>;
	qcom,board-id = <33 0>;
};
