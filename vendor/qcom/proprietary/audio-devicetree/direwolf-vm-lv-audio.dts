/dts-v1/;
/plugin/;

#include <dt-bindings/clock/qcom,gcc-direwolf.h>
#include <dt-bindings/interrupt-controller/arm-gic.h>
#include <dt-bindings/regulator/qcom,rpmh-regulator-levels.h>

#include "direwolf-vm-audio.dtsi"

/ {

	model = "Qualcomm Technologies, Inc. SA8295 Virtual Machine";
	compatible = "qcom,direwolf", "qcom,quinvm";
	qcom,msm-id = <460 0x10000>;
	qcom,board-id = <0 0x1000002>, <0 0x2000002>;
};
