/dts-v1/;
/plugin/;

#include <dt-bindings/clock/qcom,gcc-khaje.h>
#include <dt-bindings/clock/qcom,gpucc-khaje.h>
#include <dt-bindings/interrupt-controller/arm-gic.h>
#include <dt-bindings/interconnect/qcom,bengal.h>
#include "bengal-nowcd.dtsi"
/ {
        model = "Qualcomm Technologies, Inc. Khaje QRD NOWCD9375";
        compatible = "qcom,khaje-qrd", "qcom,khaje", "qcom,qrd";
	qcom,msm-id = <518 0x10000>;
	qcom,board-id = <0x2010B 0>;
	qcom,pmic-id = <0x2D 0x2E 0x0 0x0>;
};

