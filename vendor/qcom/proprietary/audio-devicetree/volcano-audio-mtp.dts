/dts-v1/;
/plugin/;

#include "volcano-audio-mtp.dtsi"

/ {
	model = "Qualcomm Technologies, Inc. volcano MTP";
	compatible = "qcom,volcano-mtp", "qcom,volcano", "qcom,mtp";
	qcom,msm-id = <636 0x10000>, <640 0x10000>, <641 0x10000>;
	qcom,board-id = <8 0>;
};
