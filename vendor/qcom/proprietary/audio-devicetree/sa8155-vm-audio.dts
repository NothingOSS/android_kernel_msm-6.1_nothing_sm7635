/dts-v1/;
/plugin/;

#include <dt-bindings/clock/qcom,gcc-sm8150.h>
#include <dt-bindings/interrupt-controller/arm-gic.h>
#include <dt-bindings/interconnect/qcom,sm8150.h>
#include <dt-bindings/regulator/qcom,rpmh-regulator-levels.h>


#include "sa8155-vm-audio.dtsi"

/ {

	model = "Qualcomm Technologies, Inc. SA8155 LA Guest Virtual Machine";
	compatible = "qcom,sa8155", "qcom,quinvm";
	qcom,msm-id = <362 0x20000>;
	qcom,board-id = <0x0 0x1000001>, <0x0 0x2000001>, <0x1000001 0x0>;
};
