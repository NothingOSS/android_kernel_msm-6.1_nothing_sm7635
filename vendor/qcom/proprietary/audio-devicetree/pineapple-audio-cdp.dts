/dts-v1/;
/plugin/;

#include "pineapple-audio-cdp.dtsi"
 / {
	model = "Qualcomm Technologies, Inc. Pineapple CDP";
	compatible = "qcom,pineapple-cdp", "qcom,pineapple", "qcom,cdp";
	qcom,msm-id = <557 0x10000>, <557 0x20000>, <577 0x10000>, <577 0x20000>,
			<682 0x10000>, <682 0x20000>;
	qcom,board-id = <1 0>;
};
