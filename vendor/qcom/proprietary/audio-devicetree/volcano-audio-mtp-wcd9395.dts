/dts-v1/;
/plugin/;

#include "volcano-audio-mtp-wcd9395.dtsi"

/ {
	model = "Qualcomm Technologies, Inc. volcano MTP + WCD9395 AATC";
	compatible = "qcom,volcano-mtp", "qcom,volcano", "qcom,volcanop-mtp", "qcom,volcanop", "qcom,mtp";
	qcom,msm-id = <636 0x10000>, <640 0x10000>, <641 0x10000>;
	qcom,board-id = <8 1>;
};
