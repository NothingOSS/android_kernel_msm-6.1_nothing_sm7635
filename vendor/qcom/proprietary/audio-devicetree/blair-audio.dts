/dts-v1/;
/plugin/;

#include <dt-bindings/clock/qcom,gcc-blair.h>
#include <dt-bindings/interrupt-controller/arm-gic.h>
#include <dt-bindings/interconnect/qcom,blair.h>
#include <dt-bindings/regulator/qcom,rpmh-regulator-levels.h>

#include "blair-audio.dtsi"

/ {
	model = "Qualcomm Technologies, Inc. Blair SoC";
	compatible = "qcom,blair";
	qcom,msm-id = <507 0x10000>, <578 0x10000>, <454 0x10000>, <472 0x10000>;
	qcom,board-id = <0 0>;
};
