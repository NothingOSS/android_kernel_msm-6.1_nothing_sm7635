/dts-v1/;
/plugin/;

#include "cliffs7-audio-mtp-wcd9395.dtsi"

/ {
	model = "Qualcomm Technologies, Inc. Cliffs MTP + HMT + 2S + NFC + WCD9395";
	compatible = "qcom,cliffs-mtp", "qcom,cliffs", "qcom,mtp";
	qcom,msm-id = <632 0x10000>, <643 0x10000>;
	qcom,board-id = <8 1>, <8 4>;
};

