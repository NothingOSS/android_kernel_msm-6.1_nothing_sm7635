/dts-v1/;
/plugin/;

#include "cliffs-ese-common.dtsi"

/ {
	model = "Qualcomm Technologies, Inc. Cliffs CDP";
	compatible = "qcom,cliffs-cdp", "qcom,cliffs", "qcom,cdp";
	qcom,msm-id = <557 0x10000>;
	qcom,board-id = <0x50001 0>;
};
