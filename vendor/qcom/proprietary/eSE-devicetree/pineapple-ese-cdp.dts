/dts-v1/;
/plugin/;

#include "pineapple-ese-common.dtsi"

/ {
	model = "Qualcomm Technologies, Inc. Pineapple CDP";
	compatible = "qcom,pineapple-cdp", "qcom,pineapple", "qcom,cdp";
	qcom,msm-id = <557 0x10000>, <682 0x10000>;
	qcom,board-id = <0x50001 0>;
};
