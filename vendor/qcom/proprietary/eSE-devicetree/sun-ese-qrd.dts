/dts-v1/;
/plugin/;

#include "sun-ese-common.dtsi"

/ {
	model = "Qualcomm Technologies, Inc. Sun QRD";
	compatible = "qcom,sun-qrd", "qcom,sun", "qcom,qrd";
	qcom,msm-id = <618 0x10000>, <618 0x20000>, <639 0x10000>, <639 0x20000>,
		      <0x100026a 0x10000>, <0x100026a 0x20000>,
		      <0x100027f 0x10000>, <0x100027f 0x20000>;
	qcom,board-id = <0x1000B 0>, <0x2000B 0>, <0x3000B 0>;
};
