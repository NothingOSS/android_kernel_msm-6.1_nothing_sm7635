/dts-v1/;
/plugin/;

#include "sun-v2-ese-common.dtsi"

/ {
    model = "Qualcomm Technologies, Inc. Sun MTP";
    compatible = "qcom, sun-mtp", "qcom,sun", "qcom,mtp";
    //AS of now for V2 devices, we have mapped the msm-id and board id same as V1.
    //We would update this once we receive the specs of V2 devices.
    qcom,msm-id = <618 0x10000>, <618 0x20000>, <639 0x10000>, <639 0x20000>,
		      <0x100026a 0x10000>, <0x100026a 0x20000>,
		      <0x100027f 0x10000>, <0x100027f 0x20000>;
    qcom,board-id = <0x8 0>, <0x20008 0>, <0x40008 0>;
};
