/dts-v1/;
/plugin/;

#include "pineapple-ese-common.dtsi"

/ {
	model = "Qualcomm Technologies, Inc. Pineapple QRD";
	compatible = "qcom,pineapple-qrd", "qcom,pineapple", "qcom,qrd";
	qcom,msm-id = <557 0x10000>, <682 0x10000>;
	qcom,board-id = <11 0>;
};
