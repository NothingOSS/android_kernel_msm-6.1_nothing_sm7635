/dts-v1/;
/plugin/;

#include "pineapple-v2-ese-common.dtsi"

/ {
    model = "Qualcomm Technologies, Inc. Pineapple CDP";
    compatible = "qcom,pineapple-cdp", "qcom,pineapple", "qcom,cdp";
    qcom,msm-id = <557 0x20000>, <577 0x20000>, <682 0x20000>;
    qcom,board-id = <0x50001 0>;
};
