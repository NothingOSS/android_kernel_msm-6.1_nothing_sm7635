/dts-v1/;
/plugin/;

#include "sun-ese-common.dtsi"

/ {
	model = "Qualcomm Technologies, Inc. Sun CDP";
	compatible = "qcom,sun-cdp", "qcom,sun", "qcom,cdp";
	qcom,msm-id = <618 0x10000>, <618 0x20000>, <639 0x10000>, <639 0x20000>,
		      <0x100026a 0x10000>, <0x100026a 0x20000>,
		      <0x100027f 0x10000>, <0x100027f 0x20000>;
	qcom,board-id = <0x1 0>, <0x20001 0>, <0x50001 0>;
};
