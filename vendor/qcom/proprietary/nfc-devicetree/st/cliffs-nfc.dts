/dts-v1/;
/plugin/;

#include "cliffs-nfc-pinctrl.dtsi"
/ {
	model = "Qualcomm Technologies, Inc. Cliffs";
	compatible = "qcom,cliffs";
	qcom,msm-id = <614 0x10000>, <632 0x10000>;
	qcom,board-id = <8 1>;
};
