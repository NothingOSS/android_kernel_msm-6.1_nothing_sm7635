/dts-v1/;
/plugin/;

#include "pineapple-nfc-common.dtsi"
/ {
	model = "Qualcomm Technologies, Inc. Pineapple MTP";
	compatible = "qcom, pineapple-mtp", "qcom,pineapple", "qcom,mtp";
	qcom,msm-id = <557 0x10000>, <557 0x20000>, <577 0x10000>, <577 0x20000>,
			<682 0x10000>, <682 0x20000>;
	qcom,board-id = <0x50008 0>;
};
