&qupv3_se9_i2c {
        status = "ok";
        qcom,clk-freq-out = <1000000>;
        #address-cells = <1>;
        #size-cells = <0>;
        st21nfc: st21nfc@08 {
                compatible = "st,st21nfc";
                reg = <0x08>;
                irq-gpios = <&tlmm 61 0x00>;
                reset-gpios = <&tlmm 114 0x00>;
                clkreq-gpios = <&tlmm 115 0x00>;
                interrupt-parent = <&tlmm>;
                interrupts = <61 0>;
                interrupt-names = "nfc_irq";
                pinctrl-names = "nfc_active", "nfc_suspend";
                pinctrl-0 = <&nfc_int_active &nfc_enable_active>;
                pinctrl-1 = <&nfc_int_suspend &nfc_enable_suspend>;
        };
};
