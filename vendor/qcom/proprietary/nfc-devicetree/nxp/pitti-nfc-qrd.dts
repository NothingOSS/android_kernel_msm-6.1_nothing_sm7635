/dts-v1/;
/plugin/;

#include "pitti-nfc-qrd-gpio.dtsi"
/ {
	model = "Qualcomm Technologies, Inc. Pitti QRD";
	compatible = "qcom,pitti-qrd", "qcom,pitti", "qcom,qrd";
	qcom,msm-id = <623 0x10000>;
	qcom,board-id = <11 0>, <11 0x501>, <11 0x600>, <11 2>;
};
