/dts-v1/;
/plugin/;

#include "pitti-nfc-common-gpio.dtsi"
/ {
	model = "Qualcomm Technologies, Inc. Pitti IDP";
	compatible = "qcom,pitti-idp", "qcom,pitti", "qcom,idp";
	qcom,msm-id = <623 0x10000>;
	qcom,board-id = <34 0>, <34 0x501>, <34 0x600>, <34 4>;
};
