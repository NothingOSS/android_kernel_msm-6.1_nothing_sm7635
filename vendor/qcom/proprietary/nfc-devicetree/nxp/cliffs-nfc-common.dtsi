&qupv3_se9_i2c {
       status = "ok";
       qcom,clk-freq-out = <1000000>;
       #address-cells = <1>;
       #size-cells = <0>;
       nq@28 {
               compatible = "qcom,sn-nci";
               reg = <0x28>;
               qcom,sn-irq = <&tlmm 61 0x00>;
               qcom,sn-ven = <&tlmm 114 0x00>;
               qcom,sn-clkreq = <&tlmm 115 0x00>;
               qcom,sn-szone = "enable";
               interrupt-parent = <&tlmm>;
               interrupts = <61 0>;
               interrupt-names = "nfc_irq";
               pinctrl-names = "nfc_active", "nfc_suspend";
               pinctrl-0 = <&nfc_int_active &nfc_enable_active>;
               pinctrl-1 = <&nfc_int_suspend &nfc_enable_suspend>;
       };
};
