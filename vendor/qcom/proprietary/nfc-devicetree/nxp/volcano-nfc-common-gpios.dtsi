#include "volcano-nfc-pinctrl.dtsi"

&qupv3_se1_i2c {
	status = "ok";
	qcom,clk-freq-out = <1000000>;
	#address-cells = <1>;
	#size-cells = <0>;
	nq@28 {
		compatible = "qcom,sn-nci";
		reg = <0x28>;
		qcom,sn-irq = <&tlmm 31 0x00>;
		qcom,sn-ven = <&tlmm 7 0x00>;
		qcom,sn-clkreq = <&tlmm 6 0x00>;
		interrupt-parent = <&tlmm>;
		interrupts = <31 0>;
		interrupt-names = "nfc_irq";
		pinctrl-names = "nfc_active", "nfc_suspend";
		pinctrl-0 = <&nfc_int_active &nfc_enable_active>;
		pinctrl-1 = <&nfc_int_suspend &nfc_enable_suspend>;
	};
};
