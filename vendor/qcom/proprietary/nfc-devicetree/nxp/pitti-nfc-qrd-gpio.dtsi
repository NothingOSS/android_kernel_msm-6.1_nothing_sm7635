#include <dt-bindings/clock/qcom,rpmcc.h>

&qupv3_se1_i2c {
	status = "ok";
	#address-cells = <1>;
	#size-cells = <0>;
	nq@28 {
		compatible = "qcom,sn-nci";
		reg = <0x28>;
		qcom,sn-irq = <&tlmm 104 0x00>;
		qcom,sn-ven = <&tlmm 103 0x00>;
		qcom,sn-firm = <&tlmm 101 0x00>;
		qcom,sn-clkreq = <&tlmm 102 0x00>;
		qcom,clk-src = "BBCLK2";
		qcom,sn-szone = "enable";
		interrupt-parent = <&tlmm>;
		interrupts = <104 0>;
		interrupt-names = "nfc_irq";
		pinctrl-names = "nfc_active", "nfc_suspend";
		pinctrl-0 = <&nfc_qrd_int_active &nfc_qrd_enable_active>;
		pinctrl-1 = <&nfc_qrd_int_suspend &nfc_qrd_enable_suspend>;
		clocks = <&rpmcc RPM_SMD_RF_CLK3>;
		clock-names = "nfc_ref_clk";
	};
};

