&soc {
        qcom_qbt: qcom,qbt_handler {
                compatible = "qcom,qbt-handler";
                qcom,ipc-gpio = <&tlmm 92 0>;
                qcom,finger-detect-gpio = <&tlmm 90 0>;
                qcom,intr2-gpio = <&tlmm 89 0>;
        };

};
