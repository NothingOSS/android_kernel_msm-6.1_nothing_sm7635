/dts-v1/;
/plugin/;

#include "pineapple-fingerprint.dtsi"

/ {
	model = "Qualcomm Technologies, Inc. Pineapple SoC";
	compatible = "qcom,pineapple";
	qcom,msm-id = <557 0x10000>, <557 0x20000>, <577 0x10000>, <577 0x20000>;
	qcom,board-id = <0 0>;
};
