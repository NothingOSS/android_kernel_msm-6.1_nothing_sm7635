/dts-v1/;
/plugin/;

#include "pineapple-dsp-trustedvm.dtsi"

/ {
	model = "Qualcomm Technologies, Inc. Pineapple - TrustedVM";
	compatible = "qcom,pineapple";
	qcom,msm-id = <557 0x10000>, <557 0x20000>, <577 0x10000>, <577 0x20000>,
		<614 0x10000>, <632 0x10000>, <642 0x10000>, <643 0x10000>,
		<636 0x10000>, <640 0x10000>, <641 0x10000>, <657 0x10000>, <658 0x10000>,
		<0x4000291 0x10000>, <0x4000292 0x10000>, <0x8000291 0x10000>, <0x8000292 0x10000>,
		<0xc000291 0x10000>, <0xc000292 0x10000>, <0x10000291 0x10000>, <0x10000292 0x10000>;
};
