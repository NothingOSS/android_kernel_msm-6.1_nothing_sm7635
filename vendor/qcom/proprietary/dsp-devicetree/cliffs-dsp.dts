/dts-v1/;
/plugin/;

#include "cliffs-dsp.dtsi"

/ {
	model = "Qualcomm Technologies, Inc. cliffs v1 SoC";
	compatible = "qcom,cliffs";
	qcom,board-id = <0 0>;
	qcom,msm-id = <614 0x10000>, <632 0x10000>, <642 0x10000>, <643 0x10000>; 
};
