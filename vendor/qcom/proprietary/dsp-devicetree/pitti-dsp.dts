/dts-v1/;
/plugin/;

#include "pitti-dsp.dtsi"

/ {
	model = "Qualcomm Technologies, Inc. Pitti";
	compatible = "qcom,pitti";
	qcom,board-id = <0 0>, <0 0x501>, <0 0x600>;
	qcom,msm-id = <623 0x10000>;
};